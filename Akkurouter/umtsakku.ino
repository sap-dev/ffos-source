#include <SPI.h>
#include <Adafruit_GFX.h>
#include <Adafruit_PCD8544.h>
// Software SPI (slower updates, more flexible pin options):// pin 7 - Serial clock out (SCLK)// pin 6 - Serial data out (DIN)// pin 5 - Data/Command select (D/C)// pin 4 - LCD chip select (CS)// pin 3 - LCD reset (RST)
Adafruit_PCD8544 display = Adafruit_PCD8544(7, 6, 5, 4, 3);

static const unsigned char PROGMEM ffos[] =
{ B00000000,B00000000,B00000000,B00000000,B00000000,B00000001,B11111111,B10000000,B00000000,B00000000,B00000000,
  B00000000,B00000000,B00000000,B00000000,B00000000,B00001111,B11110111,B11110000,B00000000,B00000000,B00000000,
  B00000000,B00000000,B00000000,B00000000,B00000000,B00111100,B00111100,B00011110,B00000000,B00000000,B00000000,
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  B00000000,B00000000,B00011111,B11110000,B00000000,B00000000,B00011100,B00000000,B00000000,B00000000,B00000000,
};

float voltage1 = 0;
float sensorValue1 = 0;
float voltage2 = 0;
float sensorValue2 = 0;
float u_min = 2.8; //minimale akkuspannung
float u_max = 4.2; //maximale akkuspannung
float trafic = 0;
int i = 0;
int online = 0;
int clientos = 0;
int offline = 0;
int clientszahl = 0;
int start = 0;
int prozent = 0;

String uhrs = "";
String clients = "";
String clientsos = "";

void setup() {
  display.begin();
  display.clearDisplay();
  display.setTextSize(1);
  display.setTextColor(BLACK);
  display.setContrast(60);
  display.setRotation(2);
  display.drawBitmap(0, 0,  ffos, 84, 48, 1);
  display.display();
  pinMode(9, OUTPUT);
  pinMode(10,OUTPUT);
}

void loop() {
  
  sensorValue1 = analogRead(A0);
  sensorValue2 = analogRead(A1);
  sensorValue2 = (sensorValue2*2);
  sensorValue2 = (sensorValue2 - sensorValue1);
  voltage1 = sensorValue1 * (5.0 / 1023.0);
  voltage2 = sensorValue2 * (5.0 / 1023.0);
  
  if((voltage1 < u_min)||(voltage2 < u_min))
  {
    delay(500);
    if((voltage1 < u_min)||(voltage2 < u_min))
    {
      digitalWrite(9,LOW);
    }
  }
  else
  {
    if(start == 0)
    {
      digitalWrite(10,HIGH);
      digitalWrite(9,HIGH);
      delay(500);
      digitalWrite(10,LOW);
      delay(40000);
      start = 1;
    }
  }
  
  //prozentabfrage
  prozent = ((voltage1 - 3)*83.33);
  
  //hauptprogramm
  
  //uhrabfrage
  Serial.begin(115200);
  delay(100);
  Serial.print("date\n");
  uhrs = Serial.readString();
  Serial.end();
  uhrs.remove(0, 17);
  uhrs.remove(5,39);
  
  //clientabfrage
  Serial.begin(115200);
  delay(100);
  Serial.print("batctl tl|wc -l\n");
  clients = Serial.readString();
  Serial.end();
  clients.remove(0, 17);
  clientszahl = (clients.toInt() -3);
  
  //abfrage statistik datei
  Serial.begin(115200);
  delay(100);
  Serial.print("rm clients_lcd.php\n");
  Serial.print("wget http://[fd74:fdaa:9dc4::16:1]/clients_lcd.php\n");
  delay(3000);
  Serial.end();
  delay(100);
  Serial.begin(115200);
  delay(100);
  Serial.print("cat clients_lcd.php\n");
  clientsos = Serial.readString();
  Serial.end();
  clientsos.remove(0, 21);
  online = clientsos.toInt();
  
  for(i=0; i<8; i++)
  {
    if(clientsos[i]=='|')
    {
      clientsos.remove(0, i+1);
      break;
    }
  }
  clientos = clientsos.toInt();
  
  for(i=0; i<8; i++)
  {
    if(clientsos[i]=='|')
    {
      clientsos.remove(0, i+1);
      break;
    }
  }
  offline = clientsos.toInt();
  
  for(i=0; i<8; i++)
  {
    if(clientsos[i]=='|')
    {
      clientsos.remove(0, i+1);
      break;
    }
  }
  trafic = clientsos.toFloat();
  
  //display ausgabe
  display.clearDisplay();
  display.setCursor(0, 0);
  display.print(uhrs); display.println("   FF-OS");
  display.print("U1 = "); display.print(voltage1); display.println("V");
  display.print("U2 = "); display.print(voltage2); display.println("V");
  display.print("Akku: "); display.print(prozent); display.println("%");
  display.print("Clients: ");
  if(clientszahl < 0)
  {
    display.println("ERROR");
  }
  else
  {
    display.println(clientszahl);
  }
  display.display();
  delay(5000);
  display.clearDisplay();
  display.setCursor(0, 0);
  display.println("Statistik OS");
  display.print("\nOnline: "); display.println(online);
  display.print("Offline: "); display.println(offline);
  display.print("Clients: "); display.println(clientos);
  display.print("RX: "); display.print(trafic); display.print("GB");
  display.display();
  delay(5000);
  display.clearDisplay();
  display.drawBitmap(0, 0,  ffos, 84, 48, 1);
  display.display();
  
  String uhrs = "";
  String clients = "";
  String clientsos = "";
}
